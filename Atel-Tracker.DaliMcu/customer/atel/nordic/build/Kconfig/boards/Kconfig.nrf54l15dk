## Atel-Tracker.DaliMcu/customer/atel/nordic/build/Kconfig/boards/Kconfig.nrf54l15dk
```kconfig
# Load board Kconfig descriptions.
osource "F:/myGithub/my-workspace/zephyr/boards/nordic/nrf54l15dk/Kconfig.nrf54l15dk"
```

## Atel-Tracker.DaliMcu/customer/atel/nordic/build/Kconfig/soc/Kconfig
```kconfig
# Load Zephyr SoC Kconfig descriptions.
osource "F:/myGithub/my-workspace/zephyr/soc/xlnx/zynqmp/Kconfig"
osource "F:/myGithub/my-workspace/zephyr/soc/xlnx/zynq7000/Kconfig"
osource "F:/myGithub/my-workspace/zephyr/soc/xlnx/versalnet/Kconfig"
osource "F:/myGithub/my-workspace/zephyr/soc/xlnx/versal2/Kconfig"
osource "F:/myGithub/my-workspace/zephyr/soc/xen/Kconfig"
osource "F:/myGithub/my-workspace/zephyr/soc/wch/ch32v/Kconfig"
osource "F:/myGithub/my-workspace/zephyr/soc/ti/simplelink/Kconfig"
osource "F:/myGithub/my-workspace/zephyr/soc/ti/mspm0/Kconfig"
osource "F:/myGithub/my-workspace/zephyr/soc/ti/lm3s6965/Kconfig"
osource "F:/myGithub/my-workspace/zephyr/soc/ti/k3/Kconfig"
osource "F:/myGithub/my-workspace/zephyr/soc/telink/tlsr/Kconfig"
osource "F:/myGithub/my-workspace/zephyr/soc/starfive/jh71xx/Kconfig"
osource "F:/myGithub/my-workspace/zephyr/soc/st/stm32/Kconfig"
osource "F:/myGithub/my-workspace/zephyr/soc/snps/qemu_arc/Kconfig"
osource "F:/myGithub/my-workspace/zephyr/soc/snps/nsim/arc_v/Kconfig"
osource "F:/myGithub/my-workspace/zephyr/soc/snps/nsim/arc_classic/Kconfig"
osource "F:/myGithub/my-workspace/zephyr/soc/snps/hsdk4xd/Kconfig"
osource "F:/myGithub/my-workspace/zephyr/soc/snps/hsdk/Kconfig"
osource "F:/myGithub/my-workspace/zephyr/soc/snps/emsk/Kconfig"
osource "F:/myGithub/my-workspace/zephyr/soc/snps/emsdp/Kconfig"
osource "F:/myGithub/my-workspace/zephyr/soc/snps/arc_iot/Kconfig"
osource "F:/myGithub/my-workspace/zephyr/soc/silabs/Kconfig"
osource "F:/myGithub/my-workspace/zephyr/soc/sifive/sifive_freedom/Kconfig"
osource "F:/myGithub/my-workspace/zephyr/soc/sensry/Kconfig"
osource "F:/myGithub/my-workspace/zephyr/soc/rockchip/Kconfig"
osource "F:/myGithub/my-workspace/zephyr/soc/renode/riscv_virtual/Kconfig"
osource "F:/myGithub/my-workspace/zephyr/soc/renode/cortex_r8_virtual/Kconfig"
osource "F:/myGithub/my-workspace/zephyr/soc/renesas/smartbond/Kconfig"
osource "F:/myGithub/my-workspace/zephyr/soc/renesas/rz/Kconfig"
osource "F:/myGithub/my-workspace/zephyr/soc/renesas/rx/Kconfig"
osource "F:/myGithub/my-workspace/zephyr/soc/renesas/rcar/Kconfig"
osource "F:/myGithub/my-workspace/zephyr/soc/renesas/ra/Kconfig"
osource "F:/myGithub/my-workspace/zephyr/soc/realtek/ec/Kconfig"
osource "F:/myGithub/my-workspace/zephyr/soc/raspberrypi/rpi_pico/Kconfig"
osource "F:/myGithub/my-workspace/zephyr/soc/quicklogic/eos_s3/Kconfig"
osource "F:/myGithub/my-workspace/zephyr/soc/qemu/virt_riscv/Kconfig"
osource "F:/myGithub/my-workspace/zephyr/soc/qemu/malta/Kconfig"
osource "F:/myGithub/my-workspace/zephyr/soc/openisa/rv32m1/Kconfig"
osource "F:/myGithub/my-workspace/zephyr/soc/openhwgroup/cva6/Kconfig"
osource "F:/myGithub/my-workspace/zephyr/soc/oct/osd32mp15x/Kconfig"
osource "F:/myGithub/my-workspace/zephyr/soc/nxp/s32/Kconfig"
osource "F:/myGithub/my-workspace/zephyr/soc/nxp/rw/Kconfig"
osource "F:/myGithub/my-workspace/zephyr/soc/nxp/mcx/Kconfig"
osource "F:/myGithub/my-workspace/zephyr/soc/nxp/lpc/Kconfig"
osource "F:/myGithub/my-workspace/zephyr/soc/nxp/layerscape/Kconfig"
osource "F:/myGithub/my-workspace/zephyr/soc/nxp/kinetis/Kconfig"
osource "F:/myGithub/my-workspace/zephyr/soc/nxp/imxrt/Kconfig"
osource "F:/myGithub/my-workspace/zephyr/soc/nxp/imx/Kconfig"
osource "F:/myGithub/my-workspace/zephyr/soc/nuvoton/numicro/Kconfig"
osource "F:/myGithub/my-workspace/zephyr/soc/nuvoton/numaker/Kconfig"
osource "F:/myGithub/my-workspace/zephyr/soc/nuvoton/npcx/Kconfig"
osource "F:/myGithub/my-workspace/zephyr/soc/nuvoton/npcm/Kconfig"
osource "F:/myGithub/my-workspace/zephyr/soc/nordic/Kconfig"
osource "F:/myGithub/my-workspace/zephyr/soc/neorv32/Kconfig"
osource "F:/myGithub/my-workspace/zephyr/soc/native/inf_clock/Kconfig"
osource "F:/myGithub/my-workspace/zephyr/soc/microchip/sam/Kconfig"
osource "F:/myGithub/my-workspace/zephyr/soc/microchip/sam/sam_d5x_e5x/Kconfig"
osource "F:/myGithub/my-workspace/zephyr/soc/microchip/miv/Kconfig"
osource "F:/myGithub/my-workspace/zephyr/soc/microchip/mec/Kconfig"
osource "F:/myGithub/my-workspace/zephyr/soc/mediatek/mt8xxx/Kconfig"
osource "F:/myGithub/my-workspace/zephyr/soc/lowrisc/opentitan/Kconfig"
osource "F:/myGithub/my-workspace/zephyr/soc/litex/litex_vexriscv/Kconfig"
osource "F:/myGithub/my-workspace/zephyr/soc/ite/ec/Kconfig"
osource "F:/myGithub/my-workspace/zephyr/soc/intel/raptor_lake/Kconfig"
osource "F:/myGithub/my-workspace/zephyr/soc/intel/panther_lake/Kconfig"
osource "F:/myGithub/my-workspace/zephyr/soc/intel/lakemont/Kconfig"
osource "F:/myGithub/my-workspace/zephyr/soc/intel/intel_socfpga_std/Kconfig"
osource "F:/myGithub/my-workspace/zephyr/soc/intel/intel_socfpga/Kconfig"
osource "F:/myGithub/my-workspace/zephyr/soc/intel/intel_niosv/Kconfig"
osource "F:/myGithub/my-workspace/zephyr/soc/intel/intel_ish/Kconfig"
osource "F:/myGithub/my-workspace/zephyr/soc/intel/intel_adsp/Kconfig"
osource "F:/myGithub/my-workspace/zephyr/soc/intel/elkhart_lake/Kconfig"
osource "F:/myGithub/my-workspace/zephyr/soc/intel/atom/Kconfig"
osource "F:/myGithub/my-workspace/zephyr/soc/intel/apollo_lake/Kconfig"
osource "F:/myGithub/my-workspace/zephyr/soc/intel/alder_lake/Kconfig"
osource "F:/myGithub/my-workspace/zephyr/soc/infineon/cat3/Kconfig"
osource "F:/myGithub/my-workspace/zephyr/soc/infineon/cat1c/Kconfig"
osource "F:/myGithub/my-workspace/zephyr/soc/infineon/cat1b/Kconfig"
osource "F:/myGithub/my-workspace/zephyr/soc/infineon/cat1a/Kconfig"
osource "F:/myGithub/my-workspace/zephyr/soc/gd/gd32/Kconfig"
osource "F:/myGithub/my-workspace/zephyr/soc/gaisler/leon3/Kconfig"
osource "F:/myGithub/my-workspace/zephyr/soc/gaisler/gr716a/Kconfig"
osource "F:/myGithub/my-workspace/zephyr/soc/espressif/Kconfig"
osource "F:/myGithub/my-workspace/zephyr/soc/ene/kb1200/Kconfig"
osource "F:/myGithub/my-workspace/zephyr/soc/ene/kb106x/Kconfig"
osource "F:/myGithub/my-workspace/zephyr/soc/efinix/sapphire/Kconfig"
osource "F:/myGithub/my-workspace/zephyr/soc/cdns/xtensa_sample_controller/Kconfig"
osource "F:/myGithub/my-workspace/zephyr/soc/cdns/sample_controller32/Kconfig"
osource "F:/myGithub/my-workspace/zephyr/soc/cdns/dc233c/Kconfig"
osource "F:/myGithub/my-workspace/zephyr/soc/brcm/bcmvk/Kconfig"
osource "F:/myGithub/my-workspace/zephyr/soc/brcm/bcm2712/Kconfig"
osource "F:/myGithub/my-workspace/zephyr/soc/brcm/bcm2711/Kconfig"
osource "F:/myGithub/my-workspace/zephyr/soc/bflb/Kconfig"
osource "F:/myGithub/my-workspace/zephyr/soc/atmel/sam0/Kconfig"
osource "F:/myGithub/my-workspace/zephyr/soc/atmel/sam/Kconfig"
osource "F:/myGithub/my-workspace/zephyr/soc/aspeed/Kconfig"
osource "F:/myGithub/my-workspace/zephyr/soc/arm/Kconfig"
osource "F:/myGithub/my-workspace/zephyr/soc/arm/beetle/Kconfig"
osource "F:/myGithub/my-workspace/zephyr/soc/antmicro/myra/Kconfig"
osource "F:/myGithub/my-workspace/zephyr/soc/andestech/Kconfig"
osource "F:/myGithub/my-workspace/zephyr/soc/amd/acp_6_0/Kconfig"
osource "F:/myGithub/my-workspace/zephyr/soc/ambiq/Kconfig"
osource "F:/myGithub/my-workspace/zephyr/soc/aesc/Kconfig"
osource "F:/myGithub/my-workspace/zephyr/soc/adi/max32/Kconfig"
osource "F:/myGithub/my-workspace/nrf/soc/sercomm/nrf91/Kconfig"
osource "F:/myGithub/my-workspace/nrf/soc/nordic/Kconfig"
```

## Atel-Tracker.DaliMcu/customer/atel/nordic/build/nordic/Kconfig/Kconfig.modules
```kconfig
menu "nrf (F:/myGithub/my-workspace/nrf)"
osource "$(ZEPHYR_NRF_KCONFIG)"
config ZEPHYR_NRF_MODULE
	bool
	default y
endmenu
menu "hostap (F:/myGithub/my-workspace/modules/lib/hostap)"
osource "$(ZEPHYR_HOSTAP_KCONFIG)"
config ZEPHYR_HOSTAP_MODULE
	bool
	default y
endmenu
menu "mcuboot (F:/myGithub/my-workspace/bootloader/mcuboot)"
osource "$(ZEPHYR_MCUBOOT_KCONFIG)"
config ZEPHYR_MCUBOOT_MODULE
	bool
	default y
endmenu
menu "mbedtls (F:/myGithub/my-workspace/modules/crypto/mbedtls)"
osource "$(ZEPHYR_MBEDTLS_KCONFIG)"
config ZEPHYR_MBEDTLS_MODULE
	bool
	default y
endmenu
menu "oberon-psa-crypto (F:/myGithub/my-workspace/modules/crypto/oberon-psa-crypto)"
osource "F:/myGithub/my-workspace/modules/crypto/oberon-psa-crypto/Kconfig.oberon_psa_crypto"
config ZEPHYR_OBERON_PSA_CRYPTO_MODULE
	bool
	default y
endmenu
menu "trusted-firmware-m (F:/myGithub/my-workspace/modules/tee/tf-m/trusted-firmware-m)"
osource "$(ZEPHYR_TRUSTED_FIRMWARE_M_KCONFIG)"
config ZEPHYR_TRUSTED_FIRMWARE_M_MODULE
	bool
	default y
endmenu
config ZEPHYR_PSA_ARCH_TESTS_MODULE
	bool
	default y
menu "cjson (F:/myGithub/my-workspace/modules/lib/cjson)"
osource "$(ZEPHYR_CJSON_KCONFIG)"
config ZEPHYR_CJSON_MODULE
	bool
	default y
endmenu
menu "azure-sdk-for-c (F:/myGithub/my-workspace/modules/lib/azure-sdk-for-c)"
osource "$(ZEPHYR_AZURE_SDK_FOR_C_KCONFIG)"
config ZEPHYR_AZURE_SDK_FOR_C_MODULE
	bool
	default y
endmenu
menu "cirrus-logic (F:/myGithub/my-workspace/modules/hal/cirrus-logic)"
osource "F:/myGithub/my-workspace/modules/hal/cirrus-logic/Kconfig"
config ZEPHYR_CIRRUS_LOGIC_MODULE
	bool
	default y
endmenu
menu "openthread (F:/myGithub/my-workspace/modules/lib/openthread)"
osource "$(ZEPHYR_OPENTHREAD_KCONFIG)"
config ZEPHYR_OPENTHREAD_MODULE
	bool
	default y
endmenu
menu "memfault-firmware-sdk (F:/myGithub/my-workspace/modules/lib/memfault-firmware-sdk)"
osource "F:/myGithub/my-workspace/modules/lib/memfault-firmware-sdk/ports/zephyr/Kconfig"
config ZEPHYR_MEMFAULT_FIRMWARE_SDK_MODULE
	bool
	default y
endmenu
menu "coremark (F:/myGithub/my-workspace/modules/benchmark/coremark)"
osource "$(ZEPHYR_COREMARK_KCONFIG)"
config ZEPHYR_COREMARK_MODULE
	bool
	default y
endmenu
menu "canopennode (F:/myGithub/my-workspace/modules/lib/canopennode)"
osource "$(ZEPHYR_CANOPENNODE_KCONFIG)"
config ZEPHYR_CANOPENNODE_MODULE
	bool
	default y
endmenu
menu "chre (F:/myGithub/my-workspace/modules/lib/chre)"
osource "F:/myGithub/my-workspace/modules/lib/chre/platform/zephyr/Kconfig"
config ZEPHYR_CHRE_MODULE
	bool
	default y
endmenu
menu "lz4 (F:/myGithub/my-workspace/modules/lib/lz4)"
osource "$(ZEPHYR_LZ4_KCONFIG)"
config ZEPHYR_LZ4_MODULE
	bool
	default y
endmenu
config ZEPHYR_TF_M_TESTS_MODULE
	bool
	default y
menu "zscilib (F:/myGithub/my-workspace/modules/lib/zscilib)"
osource "F:/myGithub/my-workspace/modules/lib/zscilib/Kconfig.zscilib"
config ZEPHYR_ZSCILIB_MODULE
	bool
	default y
endmenu
menu "cmsis (F:/myGithub/my-workspace/modules/hal/cmsis)"
osource "$(ZEPHYR_CMSIS_KCONFIG)"
config ZEPHYR_CMSIS_MODULE
	bool
	default y
endmenu
menu "cmsis-dsp (F:/myGithub/my-workspace/modules/lib/cmsis-dsp)"
osource "$(ZEPHYR_CMSIS_DSP_KCONFIG)"
config ZEPHYR_CMSIS_DSP_MODULE
	bool
	default y
endmenu
menu "cmsis-nn (F:/myGithub/my-workspace/modules/lib/cmsis-nn)"
osource "$(ZEPHYR_CMSIS_NN_KCONFIG)"
config ZEPHYR_CMSIS_NN_MODULE
	bool
	default y
endmenu
menu "cmsis_6 (F:/myGithub/my-workspace/modules/hal/cmsis_6)"
osource "$(ZEPHYR_CMSIS_6_KCONFIG)"
config ZEPHYR_CMSIS_6_MODULE
	bool
	default y
endmenu
menu "fatfs (F:/myGithub/my-workspace/modules/fs/fatfs)"
osource "$(ZEPHYR_FATFS_KCONFIG)"
config ZEPHYR_FATFS_MODULE
	bool
	default y
endmenu
menu "hal_nordic (F:/myGithub/my-workspace/modules/hal/nordic)"
osource "$(ZEPHYR_HAL_NORDIC_KCONFIG)"
config ZEPHYR_HAL_NORDIC_MODULE
	bool
	default y

config ZEPHYR_HAL_NORDIC_MODULE_BLOBS
	bool
endmenu
menu "hal_st (F:/myGithub/my-workspace/modules/hal/st)"
osource "$(ZEPHYR_HAL_ST_KCONFIG)"
config ZEPHYR_HAL_ST_MODULE
	bool
	default y
endmenu
menu "hal_tdk (F:/myGithub/my-workspace/modules/hal/tdk)"
osource "$(ZEPHYR_HAL_TDK_KCONFIG)"
config ZEPHYR_HAL_TDK_MODULE
	bool
	default y
endmenu
config ZEPHYR_HAL_WURTHELEKTRONIK_MODULE
	bool
	default y
menu "liblc3 (F:/myGithub/my-workspace/modules/lib/liblc3)"
osource "$(ZEPHYR_LIBLC3_KCONFIG)"
config ZEPHYR_LIBLC3_MODULE
	bool
	default y
endmenu
config ZEPHYR_LIBMETAL_MODULE
	bool
	default y
menu "littlefs (F:/myGithub/my-workspace/modules/fs/littlefs)"
osource "$(ZEPHYR_LITTLEFS_KCONFIG)"
config ZEPHYR_LITTLEFS_MODULE
	bool
	default y
endmenu
menu "loramac-node (F:/myGithub/my-workspace/modules/lib/loramac-node)"
osource "$(ZEPHYR_LORAMAC_NODE_KCONFIG)"
config ZEPHYR_LORAMAC_NODE_MODULE
	bool
	default y
endmenu
menu "lvgl (F:/myGithub/my-workspace/modules/lib/gui/lvgl)"
osource "F:/myGithub/my-workspace/modules/lib/gui/lvgl/zephyr/Kconfig"
config ZEPHYR_LVGL_MODULE
	bool
	default y
endmenu
config ZEPHYR_MIPI_SYS_T_MODULE
	bool
	default y
menu "nanopb (F:/myGithub/my-workspace/modules/lib/nanopb)"
osource "$(ZEPHYR_NANOPB_KCONFIG)"
config ZEPHYR_NANOPB_MODULE
	bool
	default y
endmenu
menu "nrf_wifi (F:/myGithub/my-workspace/modules/lib/nrf_wifi)"
osource "$(ZEPHYR_NRF_WIFI_KCONFIG)"
config ZEPHYR_NRF_WIFI_MODULE
	bool
	default y

config ZEPHYR_NRF_WIFI_MODULE_BLOBS
	bool
endmenu
config ZEPHYR_OPEN_AMP_MODULE
	bool
	default y
menu "percepio (F:/myGithub/my-workspace/modules/debug/percepio)"
osource "F:/myGithub/my-workspace/modules/debug/percepio/zephyr/Kconfig"
config ZEPHYR_PERCEPIO_MODULE
	bool
	default y
endmenu
menu "picolibc (F:/myGithub/my-workspace/modules/lib/picolibc)"
osource "F:/myGithub/my-workspace/modules/lib/picolibc/zephyr/Kconfig"
config ZEPHYR_PICOLIBC_MODULE
	bool
	default y
endmenu
menu "segger (F:/myGithub/my-workspace/modules/debug/segger)"
osource "$(ZEPHYR_SEGGER_KCONFIG)"
config ZEPHYR_SEGGER_MODULE
	bool
	default y
endmenu
menu "uoscore-uedhoc (F:/myGithub/my-workspace/modules/lib/uoscore-uedhoc)"
osource "$(ZEPHYR_UOSCORE_UEDHOC_KCONFIG)"
config ZEPHYR_UOSCORE_UEDHOC_MODULE
	bool
	default y
endmenu
menu "zcbor (F:/myGithub/my-workspace/modules/lib/zcbor)"
osource "$(ZEPHYR_ZCBOR_KCONFIG)"
config ZEPHYR_ZCBOR_MODULE
	bool
	default y
endmenu
menu "nrfxlib (F:/myGithub/my-workspace/nrfxlib)"
osource "F:/myGithub/my-workspace/nrfxlib/Kconfig.nrfxlib"
config ZEPHYR_NRFXLIB_MODULE
	bool
	default y
endmenu
config ZEPHYR_NRF_HW_MODELS_MODULE
	bool
	default y
menu "connectedhomeip (F:/myGithub/my-workspace/modules/lib/matter)"
osource "F:/myGithub/my-workspace/modules/lib/matter/config/nrfconnect/chip-module/Kconfig"
config ZEPHYR_CONNECTEDHOMEIP_MODULE
	bool
	default y
endmenu
```

## Atel-Tracker.DaliMcu/customer/atel/nordic/build/nordic/Kconfig/arch/Kconfig
```kconfig
# Load Zephyr Arch Kconfig descriptions.
osource "F:/myGithub/my-workspace/zephyr/arch/rx/Kconfig"
osource "F:/myGithub/my-workspace/zephyr/arch/x86/Kconfig"
osource "F:/myGithub/my-workspace/zephyr/arch/xtensa/Kconfig"
osource "F:/myGithub/my-workspace/zephyr/arch/sparc/Kconfig"
osource "F:/myGithub/my-workspace/zephyr/arch/riscv/Kconfig"
osource "F:/myGithub/my-workspace/zephyr/arch/posix/Kconfig"
osource "F:/myGithub/my-workspace/zephyr/arch/mips/Kconfig"
osource "F:/myGithub/my-workspace/zephyr/arch/arm64/Kconfig"
osource "F:/myGithub/my-workspace/zephyr/arch/arm/Kconfig"
osource "F:/myGithub/my-workspace/zephyr/arch/arc/Kconfig"
```

## Atel-Tracker.DaliMcu/customer/atel/nordic/build/nordic/Kconfig/boards/Kconfig.defconfig
```kconfig
# Load Zephyr board defconfig descriptions.
osource "F:/myGithub/my-workspace/zephyr/boards/nordic/nrf54l15dk/Kconfig.defconfig"
```

## Atel-Tracker.DaliMcu/customer/atel/nordic/build/nordic/Kconfig/boards/Kconfig.sysbuild
```kconfig
# Load Sysbuild board Kconfig descriptions.
osource "F:/myGithub/my-workspace/zephyr/boards/nordic/nrf54l15dk/Kconfig.sysbuild"
```

## west.yml
```yaml
manifest:
  remotes:
    - name: ncs
      url-base: https://github.com/nrfconnect
  projects:
    - name: nrf
      repo-path: sdk-nrf
      remote: ncs
      revision: v3.2.4   # 替换为你需要的 NCS 版本
      import: true
  self:
    path: ncsSDK_demo    # 与你的仓库名保持一致
```
